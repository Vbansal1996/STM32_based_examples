#include "TouchSensor.h"
#include "stm32g0xx_hal.h"
#include "CY8CMBR3xxx_APIs.h"
#include "CY8CMBR3xxx_CommandsAndConfig.h"
#include "CY8CMBR3xxx_Registers.h"
#include "stdio.h"

CY8CMBR3xxx_SENSORSTATUS s_SensorStatus;

const unsigned char configration[128] =
{
    0x3B, 0x00, 0x3B, 0x00, 0x00, 0x00, 0x00, 0x00,
    0x00, 0x00, 0x00, 0x00, 0x80, 0x80, 0x7F, 0x80,
    0x80, 0x80, 0x7F, 0x7F, 0x00, 0x00, 0x00, 0x00,
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    0x00, 0x00, 0x00, 0x00, 0x00, 0x00, 0xAE, 0x25
};


void TouchSensorInit(void)
{				 
	
	if(!CY8CMBR3xxx_Configure(TOUCH_SLAVE_ADDRESS, configration))
	{
		printf("Touch Sensor Init Fail\n");
	}

	if(!CY8CMBR3xxx_ReadSensorStatus(TOUCH_SLAVE_ADDRESS, &s_SensorStatus))
	{
		printf("Touch Sensor Read Fail\n");
	}
}

void EXTI2_3_IRQHandler(void)
{
	TouchISR();
}

void TouchISR(void)
{
	if(!CY8CMBR3xxx_ReadSensorStatus(TOUCH_SLAVE_ADDRESS, &s_SensorStatus)) {
		printf("Touch sensor Read Fail\n");
		return;
	}
	if(!CY8CMBR3xxx_SendCommand(TOUCH_SLAVE_ADDRESS, 8)) {
		printf("Touch sensor Read Fail\n");
		return;
	}

	if(s_SensorStatus.buttonStatus >> BUTTON1 == PRESSED)
	{
		printf("Button 1 pressed\n");
	}

	else if(s_SensorStatus.buttonStatus >> BUTTON2 == PRESSED)
	{
		printf("Button 2 pressed\n");
	}

	else if(s_SensorStatus.buttonStatus >> BUTTON3 == PRESSED)
	{
		printf("Button 3 pressed\n");
	}

	else if(s_SensorStatus.buttonStatus >> BUTTON4 == PRESSED)
	{
		printf("Button 4 pressed\n");
	}

	else if(s_SensorStatus.buttonStatus >> BUTTON5 == PRESSED)
	{
		printf("Button 5 pressed\n");
	}
}